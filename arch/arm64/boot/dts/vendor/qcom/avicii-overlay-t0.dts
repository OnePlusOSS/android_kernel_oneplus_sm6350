/dts-v1/;
/plugin/;

#include <dt-bindings/interrupt-controller/arm-gic.h>
#include "lito-mtp.dtsi"

#include "avicii.dtsi"
#include "avicii-t0.dtsi"
#include "camera/lito-oem-camera-avicii.dtsi"


/ {
	model = "Qualcomm Technologies, Inc. Lito MTP T0 20801 11";
	compatible = "qcom,lito-mtp", "qcom,lito", "qcom,mtp";
	qcom,board-id = <8 0>;
	/*we can add project id to this array,uefi can auto read it,if new project,we add to this array */
	oem,project-id = <20801>;
	/*we can add hw id to this array,uefi can auto read it,if new hw,we add to this array  */
	oem,hw-id = <11>;
};

&ufsphy_mem {
	/delete-property/ vdda-phy-always-on;
};
