## drivers/input/fingerprint/Kconfig
```kconfig
#
# S86260AA1 WT Fingerprint driver configuration
#

config FINGERPRINT_EGIS520
	bool "fingerprint egis"
	default n
	help
	  Say Y here if you have a egis
          If unsure, say N.
```

## drivers/oneplus/wt_sys/Kconfig
```kconfig
config WT_BOOT_REASON
	tristate "CONFIG_WT_BOOT_REASON"
	default n
	help
	  support for bootreason.Dmesg print
	  wt_boot_reason to help analyze stability issue.

config PRESS_KEY_TRIGGER_PANIC
	bool "Enable press hot key trigger the crash"
	default n
	help
	  Press the power button, volume up button
	  and volume down button to trigger the crash.

config WT_SYSTEM_MONITOR
	tristate "CONFIG_WT_SYSTEM_MONITOR"
	default n
```
